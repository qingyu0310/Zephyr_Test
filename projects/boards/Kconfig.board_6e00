## projects/boards/Kconfig.board_6e00
```kconfig
# Copyright (c) 2025 HPMicro
# SPDX-License-Identifier: Apache-2.0

config BOARD_BOARD_6E00
	bool
	select SOC_HPM6E80
```

## projects/boards/board.yml
```yaml
board:
  name: board_6e00
  full_name: Custom HPM6E00 Board
  vendor: hpmicro
  socs:
    - name: hpm6e80
```

## projects/thread/Kconfig
```kconfig
# projects/thread/Kconfig — 线程与项目配置（应用层）
# 统一 rsource 所有子模块的 Kconfig
# 定义 TRD_* 线程开关、USE_* 功能开关、USER_* 调试开关
# 每个 TRD_* 负责 select 其所依赖的子模块 config，不依赖 prj.conf 手动配置

rsource "../../drivers/Kconfig"
rsource "../../algorithm/Kconfig"
rsource "../../modules/Kconfig"
rsource "../../topic/Kconfig"
rsource "../../cmd/shell/Kconfig"

######################################################

# gpio线程 翻转led灯，用来反应代码是否运行
config TRD_GPIO
    default y
    bool "GPIO thread task"
    select DEV_GPIO
    select CTL_TIMER
    help
        使能GPIO线程

######################################################

# chassis线程
config TRD_CHASSIS
    default y
    bool "Chassis control thread"
    select MOD_CTL_POWER
    select MOD_DEV_MOTOR_DJI
    select TPC_TO_CAN_TX
    select TPC_REMOTE_TO

    help
        使能底盘控制线程

# 是否开启功率计
config USE_POWERMETER
    bool "Power meter"
    depends on TRD_CHASSIS
    default n
    select MOD_DEV_POWERMETER
    help
        使能功率计（依赖底盘线程开启）

######################################################

# gimbal线程
config TRD_GIMBAL
    default n
    bool "Gimbal control thread"
    select CTL_PID
    select MOD_DEV_MOTOR_DM
    select TPC_TO_CAN_TX
    select TPC_REMOTE_TO

    help
        使能云台控制线程

######################################################

# can发送线程
config TRD_CAN_TX
    default y
    bool "CAN TX thread"
    select COM_CAN
    select TPC_TO_CAN_TX
    help
        使能CAN发送线程，从消息队列取帧发送

######################################################

# remote线程
config TRD_REMOTE
    default y
    bool "Remote thread"
    select MOD_DEV_REMOTE
    help
        使能遥控线程

######################################################

# tflm线程（默认关闭，需测试时手动开）
config TRD_TFLM
    bool "TFLM inference thread"
    default y
    select TFLM
    help
        使能 TFLM 推理测试线程

######################################################

# 用户添加测试
config USER_TEST_ADD
    default y
    bool "user's test add config"
    help
        临时添加你想测试的config
```

## topic/Kconfig
```kconfig
# topic/Kconfig — 线程间数据通道
# 基于 zbus 定义模块间通信的 topic（发布/订阅）
# 每一对 config 定义一个 topic，select ZBUS
# 头文件在 topic/ 下

config TPC_CHASSIS_TO_CAN
    default n
    bool "Chassis- CAN channel"
    select ZBUS
    help
        chassis 发布 → can_tx 订阅

config TPC_REMOTE_TO
    default n
    bool "Remote channel"
    select ZBUS
    help
        遥控器数据 zbus 通道
```
